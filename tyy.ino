/*
 Name:		涂鸦.ino
 Created:	2021/3/29 14:39:17
 Author:	Administrator
*/

#include <Wire.h>
#include <U8x8lib.h>
#include"src\\wifi.h"
#include<Arduino.h>
#include<u8g2lib.h>
#include<stm32_eeprom.h>

#define eating_w 128
#define	 eating_h 64
static uint8_t eating_bits[]= {
   0x00, 0x00, 0x00, 0x00, 0x00, 0x00, 0x00, 0x00, 0x00, 0x00, 0x00, 0x00,
   0x00, 0x00, 0x00, 0x00, 0x00, 0x00, 0x00, 0x00, 0x00, 0x00, 0x00, 0x00,
   0x00, 0x00, 0x00, 0x00, 0x00, 0x00, 0x00, 0x00, 0x00, 0x00, 0x00, 0x00,
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   0x00, 0x00, 0x00, 0x00 };



//配置U8G2，控制器SSD1306，分辨率128*64，缓存页数 1，接口类型：I2C
//参数U8G2_R0不旋转  u8g2_font_10x20_mf
U8G2_SSD1306_128X64_NONAME_1_HW_I2C u8g2(U8G2_R0, /* reset=*/ U8X8_PIN_NONE,/* clock=*/SCL_LED,/* data=*/SDA_LED);
// the setup function runs once when you press reset or power the board


//********************全局变量***********************


bool display_flash_flag = true;//显示屏刷新标记。true刷新
bool up_button_flag = false;//上按钮标记
bool down_button_flag = false;//下按钮标记
bool ok_button_flag = false;//ok按钮标记
//**************************************************

//****************可下发可上报DP***********************
unsigned char* ty_meal_plan = (unsigned char*)"ssssssss";//喂食计划 最大长度：128
bool ty_quick_feed;	//快速喂食 BOOL型数据上报;
int ty_manual_feed=1; //手动喂食 VALUE型数据上报;数值范围：1-12，间距：1，单位：null
//**************************************************


//****************只上报DP***********************

enum feed_state ty_feed_state;
int ty_battery_percentage; //电池电量 VALUE型数据上报;数值范围：0-100，间距：1，单位：%
bool ty_charge_state; //充电状态 BOOL型数据上报;
//ty_fault; //故障型数据上报;标签：pet_food_jam,pet_food_shortages,pet_food_run_out,desiccant_exhausted,battery_low
int ty_feed_report; //喂食结果 VALUE型数据上报;数值范围：0-12，间距：1，单位：null
int ty_surplus_grain; //当前粮桶余粮 VALUE型数据上报;数值范围：0-100，间距：1，单位：%
//**************************************************


void feed_open(uint8_t num);
void display(uint8_t num);
void up_button();
void down_button();
void ok_botton();
void save_eeprom_data();
void serialEvent1();
void ty_write(unsigned char value);

void wifi_state_tips();

void setup() {
	Serial1.begin(115200);

	pinMode(WIFI_STATE_PIN, OUTPUT);
	pinMode(MUP_PIN, INPUT);		//电机上升限位
	pinMode(MDOWN_PIN, INPUT);	//电机下降限位
	pinMode(FI1_PIN, OUTPUT);		//出粮电机
	pinMode(BI1_PIN, OUTPUT);		//出粮电机
	pinMode(FI2_PIN, OUTPUT);		//升降电机，上升
	pinMode(BI2_PIN, OUTPUT);		//升降电机，下降
	pinMode(CHKWATER_PIN, INPUT_ANALOG);	//5v上拉电阻10k,水位传感器变阻器模拟输入。
	pinMode(WATER_PIN, OUTPUT);		//水泵驱动mos G极引脚，高电平有效
	pinMode(OKBTN3_PIN, INPUT_PULLDOWN);	//按钮
	pinMode(DOWNBTN2_PIN, INPUT_PULLDOWN);	//按钮
	pinMode(UPBTN_PIN, INPUT_PULLDOWN);	//按钮
	
	//初始化输出引脚
	digitalWrite(FI1_PIN, LOW);
	digitalWrite(BI1_PIN, LOW);
	digitalWrite(FI2_PIN, LOW);
	digitalWrite(BI2_PIN, LOW);

	digitalWrite(WATER_PIN, LOW);
	digitalWrite(WIFI_STATE_PIN, HIGH);
	u8g2.begin();
	if (eeprom_read_byte(0) == 0xFF) {
		ty_manual_feed = eeprom_read_byte(1);
	}

	//附加中断
	attachInterrupt(UPBTN_PIN, up_button, RISING);
	attachInterrupt(DOWNBTN2_PIN, down_button, RISING);
	attachInterrupt(OKBTN3_PIN, ok_botton, RISING);




	wifi_protocol_init();//完成其他初始化后初始化wifi

}

// the loop function runs over and over again until power down or reset
void loop() {

	unsigned char wifi_state;
	wifi_uart_service();//wifi串口处理
	wifi_state_tips();//wifi指示灯

	//屏幕刷新判断
	if (display_flash_flag == true) {
		display_flash_flag = false;
		display(ty_manual_feed);
	}
	//按“上”按钮
	if (up_button_flag == true) {
		delay(200);
		up_button_flag = false;
		display_flash_flag = true;
		if (ty_manual_feed < 12)
			ty_manual_feed++;
		else
			ty_manual_feed = 12;
		save_eeprom_data();
		mcu_dp_value_update(DPID_MANUAL_FEED, ty_manual_feed);
	}
	//按“下”按钮
	if (down_button_flag == true) {
		delay(200);
		down_button_flag = false;
		display_flash_flag = true;
		if (ty_manual_feed > 1)
			ty_manual_feed--;
		else
			ty_manual_feed = 1;
		save_eeprom_data();
		mcu_dp_value_update(DPID_MANUAL_FEED, ty_manual_feed);
	}
	//按“OK”按钮
	if (ok_button_flag == true) {
		//delay(200);
		
		//display_flash_flag = true;

		feed_open(ty_manual_feed);
		ok_button_flag = false;
	}

}

/***
 * @brief  串口接收数据中断
 * @param[in] Null
 * @return Null
 * @note   在MCU串口处理函数中调用涂鸦的串口输入函数,并将接收到的数据作为参数传入
 */
void serialEvent1() {
	//statements
	int i = Serial1.available();
	if (i == 1) {
		uart_receive_input(Serial1.read());
		return;
	}
	if (i > 1)
	{
		uart_receive_buff_input((unsigned char*)Serial1.readString().c_str(), i);
		return;
	}
}

/***
* @brief wifi状态指示灯
* @param[in] Null
* @return Null
* @note 根据获取的状态改变指示灯状态
*/
void wifi_state_tips() {
	static uint32_t m = 0;//存储上次操作时间
	uint32_t m2 = millis();//现在时间
	switch (mcu_get_wifi_work_state()) {
		//smart或共存配置状态，快闪，间隔 250ms
	case SMART_AND_AP_STATE:
	case SMART_CONFIG_STATE:
		if (m2 >= m + 250) {
			digitalWrite(WIFI_STATE_PIN, !digitalRead(WIFI_STATE_PIN));
			m = m2;
		}
		break;
		//AP 配置状态，慢闪，间隔 1500ms
	case AP_STATE:
		if (m2 >= m + 1500) {
			digitalWrite(WIFI_STATE_PIN, !digitalRead(WIFI_STATE_PIN));
			m = m2;
		}
		break;
		//低功耗模式/已配置未连接wifi状态，熄灭
	case WIFI_LOW_POWER:
	case WIFI_NOT_CONNECTED:
		digitalWrite(WIFI_STATE_PIN, HIGH);
		break;
		//已连上WiFi或者涂鸦云，常亮
	case WIFI_CONNECTED:
	case WIFI_CONN_CLOUD:
		digitalWrite(WIFI_STATE_PIN, LOW);
		break;
	}
}

/***
* @brief 出粮
* @param[in] {num} 出粮份数，每份运转0.3秒
* @return Null
* @note 打开闸门，旋转扫粮方式出粮，出粮计量粗略计算
*/
void feed_open(uint8_t num) {
	mcu_dp_enum_update(DPID_FEED_STATE, feeding);
	u8g2.firstPage();
	do {
		u8g2.drawXBMP(0, 0, eating_w, eating_h, eating_bits);
	} while (u8g2.nextPage());
	digitalWrite(FI2_PIN, HIGH);		//升降电机上升
	//digitalWrite(BI2_PIN, LOW);
	//delay(100);
	while (1) {	//当电平被拉高时限位生效
		if (digitalRead(MUP_PIN) == HIGH)
			break;
		delay(10);
	}
	digitalWrite(FI2_PIN, LOW);		//升降电机停止
	//digitalWrite(BI2_PIN, LOW);

	digitalWrite(FI1_PIN, HIGH);	//出粮电机启动
	delay(num * 300);
	digitalWrite(FI1_PIN, LOW);	//出粮电机停止

	mcu_dp_enum_update(DPID_FEED_STATE, done);
	delay(1000);//延迟1秒关闸门
	digitalWrite(FI2_PIN, LOW);
	digitalWrite(BI2_PIN, HIGH);		//升降电机下降
	//delay(100);
	while (1) {	//检测到达下限位
		if (digitalRead(MDOWN_PIN) == HIGH)
			break;
		delay(10);
	}
	digitalWrite(BI2_PIN, LOW);		//升降电机停止

	u8g2.firstPage();
	do {
		u8g2.setCursor(40, 40);
		u8g2.print("DONE.");
	} while (u8g2.nextPage());

	mcu_dp_enum_update(DPID_FEED_STATE, standby);
	mcu_dp_value_update(DPID_FEED_REPORT, num);
	display_flash_flag = true;
	delay(500);
}

/***
* @brief 显示手动喂粮份数
* @param[in] {num} 喂粮份数
* @return	Null
* @note 配合按钮实现本地手动喂粮
*/
void display(uint8_t num) {
	u8g2.setFont(u8g2_font_10x20_tf);
	u8g2.firstPage();
	do {
		u8g2.setCursor(0, 40);
		u8g2.print("FOOD:");
		u8g2.print(num);
	} while (u8g2.nextPage());
}

/**
* @brief 保存数据到EEPROM
* @param[in] NULL
* @return NULL
* @note  保存喂食份数
*
*/
void save_eeprom_data() {
	if (eeprom_read_byte(0) != 0xFF)
		eeprom_write_byte(0, 0xFF);
	eeprom_write_byte(1, ty_manual_feed);
}

/**
* @brief 向上按钮按下事件
* @param[in] Null
* @return Null
* @note 按一下增加一份的分量
*/
void up_button() {
	up_button_flag = true;
}




/**
* @brief 向下按钮按下事件
* @param[in] Null
* @return Null
* @note 按一下减少一份的分量
*/
void down_button() {
	down_button_flag = true;
}


/**
* @brief 确认按钮按下事件
* @param[in] Null
* @return Null
* @note 按下后投放num份口粮
*/
void ok_botton() {
	ok_button_flag = true;
}


/**
* @brief 串口写1字节
* @param[in] {value} 写入的数据
* @return Null
* @note 
*/
void ty_write(unsigned char value) {
	Serial1.write(value);

}